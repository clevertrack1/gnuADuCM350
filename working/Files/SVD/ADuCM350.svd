# ADuCM350 register map
Vendor: Analog Devices; Series: ARMCM3; File version: 0.1
CPU: CM3 r2p1, little endian, no MPU, no FPU, 3 interrupt priority bits
Registers are 16-bit, access not given, no defined reset value unless marked. A register's access mark holds for its fields unless they carry their own. Offsets are from the block's base; [hi:lo] are bit positions.

## AFE — Analog Front End
Base 0x40080000
0x00 REG_AFE_AFE_CFG — AFE AFE Configuration
  [15:0] VALUE
0x04 REG_AFE_AFE_SEQ_CFG — AFE Sequencer Configuration
  [15:0] VALUE
0x08 REG_AFE_AFE_FIFO_CFG — AFE FIFOs Configuration
  [15:0] VALUE
0x0C REG_AFE_AFE_SW_CFG — AFE Switch Matrix Configuration
  [15:0] VALUE
0x10 REG_AFE_AFE_DAC_CFG — AFE DAC Configuration
  [15:0] VALUE
0x14 REG_AFE_AFE_WG_CFG — AFE Waveform Generator Configuration
  [15:0] VALUE
0x18 REG_AFE_AFE_WG_DCLEVEL_1 — AFE Waveform Generator - Trapezoid DC Level 1
  [15:0] VALUE
0x1C REG_AFE_AFE_WG_DCLEVEL_2 — AFE Waveform Generator - Trapezoid DC Level 2
  [15:0] VALUE
0x20 REG_AFE_AFE_WG_DELAY_1 — AFE Waveform Generator - Trapezoid Delay 1 Time
  [15:0] VALUE
0x24 REG_AFE_AFE_WG_SLOPE_1 — AFE Waveform Generator - Trapezoid Slope 1 Time
  [15:0] VALUE
0x28 REG_AFE_AFE_WG_DELAY_2 — AFE Waveform Generator - Trapezoid Delay 2 Time
  [15:0] VALUE
0x2C REG_AFE_AFE_WG_SLOPE_2 — AFE Waveform Generator - Trapezoid Slope 2 Time
  [15:0] VALUE
0x30 REG_AFE_AFE_WG_FCW — AFE Waveform Generator - Sinusoid Frequency Control Word
  [15:0] VALUE
0x34 REG_AFE_AFE_WG_PHASE — AFE Waveform Generator - Sinusoid Phase Offset
  [15:0] VALUE
0x38 REG_AFE_AFE_WG_OFFSET — AFE Waveform Generator - Sinusoid Offset
  [15:0] VALUE
0x3C REG_AFE_AFE_WG_AMPLITUDE — AFE Waveform Generator - Sinusoid Amplitude
  [15:0] VALUE
0x40 REG_AFE_AFE_ADC_CFG — AFE ADC Configuration
  [15:0] VALUE
0x44 REG_AFE_AFE_SUPPLY_LPF_CFG — AFE Supply Rejection Filter Configuration
  [15:0] VALUE
0x48 REG_AFE_AFE_SW_FULL_CFG_MSB — AFE Switch Matrix Full Configuration (MSB)
  [15:0] VALUE
0x4C REG_AFE_AFE_SW_FULL_CFG_LSB — AFE Switch Matrix Full Configuration (LSB)
  [15:0] VALUE
0x54 REG_AFE_AFE_WG_DAC_CODE — AFE Waveform Generator - DAC Code
  [15:0] VALUE
0x58 REG_AFE_AFE_STATUS — AFE AFE Status
  [15:0] VALUE
0x60 REG_AFE_AFE_SEQ_CRC — AFE Sequencer CRC Value
  [15:0] VALUE
0x64 REG_AFE_AFE_SEQ_COUNT — AFE Sequencer Command Count
  [15:0] VALUE
0x68 REG_AFE_AFE_SEQ_TIMEOUT — AFE Sequencer Timeout Counter
  [15:0] VALUE
0x6C REG_AFE_AFE_DATA_FIFO_READ — AFE Data FIFO Read
  [15:0] VALUE
0x70 REG_AFE_AFE_CMD_FIFO_WRITE — AFE Command FIFO Write
  [15:0] VALUE
0x74 REG_AFE_AFE_ADC_RESULT — AFE ADC Raw Result
  [15:0] VALUE
0x78 REG_AFE_AFE_DFT_RESULT_REAL — AFE DFT Result, Real Part
  [15:0] VALUE
0x7C REG_AFE_AFE_DFT_RESULT_IMAG — AFE DFT Result, Imaginary Part
  [15:0] VALUE
0x80 REG_AFE_AFE_SUPPLY_LPF_RESULT — AFE Supply Rejection Filter Result
  [15:0] VALUE
0x84 REG_AFE_AFE_TEMP_SENSOR_RESULT — AFE Temperature Sensor Result
  [15:0] VALUE
0x8C REG_AFE_AFE_ANALOG_CAPTURE_IEN — AFE Analog Capture Interrupt Enable
  [15:0] VALUE
0x90 REG_AFE_AFE_ANALOG_GEN_IEN — AFE Analog Generation Interrupt Enable
  [15:0] VALUE
0x94 REG_AFE_AFE_CMD_FIFO_IEN — AFE Command FIFO Interrupt Enable
  [15:0] VALUE
0x98 REG_AFE_AFE_DATA_FIFO_IEN — AFE Data FIFO Interrupt Enable
  [15:0] VALUE
0xA0 REG_AFE_AFE_ANALOG_CAPTURE_INT — AFE Analog Capture Interrupt
  [15:0] VALUE
0xA4 REG_AFE_AFE_ANALOG_GEN_INT — AFE Analog Generation Interrupt
  [15:0] VALUE
0xA8 REG_AFE_AFE_CMD_FIFO_INT — AFE Command FIFO Interrupt
  [15:0] VALUE
0xAC REG_AFE_AFE_DATA_FIFO_INT — AFE Data FIFO Interrupt
  [15:0] VALUE
0xB0 REG_AFE_AFE_SW_STATUS_MSB — AFE Switch Matrix Status MSB
  [15:0] VALUE
0xB4 REG_AFE_AFE_SW_STATUS_LSB — AFE Switch Matrix Status (LSB)
  [15:0] VALUE
0xB8 REG_AFE_AFE_ADCMIN — AFE ADC Minimum Value Check
  [15:0] VALUE
0xBC REG_AFE_AFE_ADCMAX — AFE ADC Maximum Value Check
  [15:0] VALUE
0xC0 REG_AFE_AFE_ADCDELTA — AFE ADC Delta Check
  [15:0] VALUE
0x100 REG_AFE_AFE_CAL_DATA_LOCK — AFE Calibration Data Lock
  [15:0] VALUE
0x104 REG_AFE_AFE_ADC_GAIN_TIA — AFE ADC Gain (TIA Measurement)
  [15:0] VALUE
0x108 REG_AFE_AFE_ADC_OFFSET_TIA — AFE ADC Offset (TIA Measurement)
  [15:0] VALUE
0x10C REG_AFE_AFE_ADC_GAIN_TEMP_SENS — AFE ADC Gain (Temperature Sensor Measurement)
  [15:0] VALUE
0x110 REG_AFE_AFE_ADC_OFFSET_TEMP_SENS — AFE ADC Offset (Temperature Sensor Measurement)
  [15:0] VALUE
0x118 REG_AFE_AFE_ADC_GAIN_AUX — AFE ADC Gain (Aux Channel Measurement)
  [15:0] VALUE
0x11C REG_AFE_AFE_ADC_OFFSET_AUX — AFE ADC Offset (Aux Channel Measurement)
  [15:0] VALUE
0x120 REG_AFE_AFE_DAC_OFFSET_UNITY — AFE DAC Offset With Attenuator Disabled
  [15:0] VALUE
0x124 REG_AFE_AFE_DAC_OFFSET_ATTEN — AFE DAC Offset With Attenuator Enabled
  [15:0] VALUE
0x128 REG_AFE_AFE_DAC_GAIN — AFE DAC Gain
  [15:0] VALUE
0x12C REG_AFE_AFE_REF_TRIM0 — AFE Precision Reference Trim 0
  [15:0] VALUE
0x130 REG_AFE_AFE_REF_TRIM1 — AFE Precision Reference Trim 1
  [15:0] VALUE
0x134 REG_AFE_AFE_ALDO_TRIM — AFE Analog LDO Trim
  [15:0] VALUE
0x138 REG_AFE_AFE_DAC_TRIM — AFE DAC Trim
  [15:0] VALUE
0x13C REG_AFE_AFE_INAMP_TRIM — AFE INAMP Trim
  [15:0] VALUE
0x140 REG_AFE_AFE_EXBUF_TRIM — AFE Excitation Buffer Trim
  [15:0] VALUE
0x144 REG_AFE_AFE_TEMP_SENS_TRIM — AFE Temperature Sensor Trim
  [15:0] VALUE
