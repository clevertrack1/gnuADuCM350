# ADuCM350 register map
Vendor: Analog Devices; Series: ARMCM3; File version: 0.1
CPU: CM3 r2p1, little endian, no MPU, no FPU, 3 interrupt priority bits
Registers are 16-bit, access not given, no defined reset value unless marked. A register's access mark holds for its fields unless they carry their own. Offsets are from the block's base; [hi:lo] are bit positions; {n}, {i} and the like mark numbered series.

## USB0 — USB Controller
Base 0x400A0000
0x00 REG_USB0_FADDR 8-bit — USB0 Function Address Register
  [7:0] VALUE
0x01 REG_USB0_POWER 8-bit — USB0 Power and Device Control Register
  [7:0] VALUE
0x02 REG_USB0_INTRTX 8-bit — USB0 Transmit Interrupt Register
  [7:0] VALUE
0x04 REG_USB0_INTRRX — USB0 Receive Interrupt Register
  [15:0] VALUE
0x06 REG_USB0_INTRTXE — USB0 Transmit Interrupt Enable Register
  [15:0] VALUE
0x08 REG_USB0_INTRRXE — USB0 Receive Interrupt Enable Register
  [15:0] VALUE
0x0A REG_USB0_IRQ 8-bit — USB0 Common Interrupts Register
  [7:0] VALUE
0x0B REG_USB0_IEN 8-bit — USB0 Common Interrupts Enable Register
  [7:0] VALUE
0x0C REG_USB0_FRAME — USB0 Frame Number Register
  [15:0] VALUE
0x0E REG_USB0_INDEX 8-bit — USB0 Index Register
  [7:0] VALUE
0x0F REG_USB0_TESTMODE 8-bit — USB0 Testmode Register
  [7:0] VALUE
0x10 REG_USB0_EPI_TXMAXP0 — USB0 EPn Transmit Maximum Packet Length Register
  [15:0] VALUE
0x12 REG_USB0_EPI_TXCSR_P0 — USB0 EPn Transmit Configuration and Status (Peripheral) Register
  [15:0] VALUE
0x14 REG_USB0_EPI_RXMAXP0 — USB0 EPn Receive Maximum Packet Length Register
  [15:0] VALUE
0x18 REG_USB0_EP0I_CNT0 — USB0 EP0 Number of Received Bytes Register
  [15:0] VALUE
0x1F REG_USB0_EP0I_CFGDATA0 8-bit — USB0 EP0 Configuration Information Register
  [7:0] VALUE
0x20 REG_USB0_FIFO0 — USB0 FIFO Word (32-Bit) Register
  [15:0] VALUE
0x24 REG_USB0_FIFO1 — USB0 FIFO Word (32-Bit) Register
  [15:0] VALUE
0x28 REG_USB0_FIFO2 32-bit — USB0 FIFO Word (32-Bit) Register
  [15:0] VALUE
0x2C REG_USB0_FIFO3 — USB0 FIFO Word (32-Bit) Register
  [15:0] VALUE
0x60 REG_USB0_DEV_CTL 8-bit — USB0 Device Control Register
  [7:0] VALUE
0x61 REG_USB0_MISC 8-bit — USB0 Miscellaneous Register
  [7:0] VALUE
0x78 REG_USB0_EPINFO 8-bit — USB0 Endpoint Information Register
  [7:0] VALUE
0x79 REG_USB0_RAMINFO 8-bit — USB0 RAM Information Register
  [7:0] VALUE
0x7A REG_USB0_LINKINFO — USB0 Link Information Register
  [15:0] VALUE
0x7D REG_USB0_FS_EOF1 8-bit — USB0 Full-Speed EOF 1 Register
  [7:0] VALUE
0x7F REG_USB0_SOFT_RST 8-bit — USB0 Software Reset Register
  [7:0] VALUE
{0x100+0x10*i} REG_USB0_EP{i}_TXMAXP (i=0..3) — USB0 EPn Transmit Maximum Packet Length Register
  [15:0] VALUE
{0x102+0x10*i} REG_USB0_EP{i}_TXCSR_P (i=0..3) — USB0 EPn Transmit Configuration and Status (Peripheral) Register
  [15:0] VALUE
{0x104+0x10*i} REG_USB0_EP{i}_RXMAXP (i=0..3) — USB0 EPn Receive Maximum Packet Length Register
  [15:0] VALUE
{0x106+0x10*i} REG_USB0_EP{i}_RXCSR_P (i=0..3) — USB0 EPn Receive Configuration and Status (Peripheral) Register
  [15:0] VALUE
0x108 REG_USB0_EP0_CNT0 — USB0 EP0 Number of Received Bytes Register
  [15:0] VALUE
{0x108+0x10*i} REG_USB0_EP{i}_RXCNT (i=1..3) — USB0 EPn Number of Bytes Received Register
  [15:0] VALUE
0x200 REG_USB0_DMA_IRQ — USB0 DMA Interrupt Register
  [15:0] VALUE
0x204 REG_USB0_DMA0_CTL — USB0 DMA Channel n Control Register
  [15:0] VALUE
0x208 REG_USB0_DMA0_ADDR — USB0 DMA Channel n Address Register
  [15:0] VALUE
0x20C REG_USB0_DMA0_CNT — USB0 DMA Channel n Count Register
  [15:0] VALUE
0x214 REG_USB0_DMA1_CTL — USB0 DMA Channel n Control Register
  [15:0] VALUE
0x218 REG_USB0_DMA1_ADDR — USB0 DMA Channel n Address Register
  [15:0] VALUE
0x21C REG_USB0_DMA1_CNT — USB0 DMA Channel n Count Register
  [15:0] VALUE
0x340 REG_USB0_RXDPKTBUFDIS — USB0 RX Double Packet Buffer Disable for Endpoints 1 to 3
  [15:0] VALUE
0x342 REG_USB0_TXDPKTBUFDIS — USB0 TX Double Packet Buffer Disable for Endpoints 1 to 3
  [15:0] VALUE
0x344 REG_USB0_CT_UCH — USB0 Chirp Timeout Register
  [15:0] VALUE
0x360 REG_USB0_LPM_ATTR — USB0 LPM Attribute Register
  [15:0] VALUE
0x362 REG_USB0_LPM_CTL 8-bit — USB0 LPM Control Register
  [7:0] VALUE
0x363 REG_USB0_LPM_IEN 8-bit — USB0 LPM Interrupt Enable Register
  [7:0] VALUE
0x364 REG_USB0_LPM_IRQ 8-bit — USB0 LPM Interrupt Status Register
  [7:0] VALUE
0x39C REG_USB0_PHY_CTL — USB0 FS PHY Control
  [15:0] VALUE
0x39E REG_USB0_PHY_STAT — USB0 FS PHY Status
  [15:0] VALUE
0x3B0 REG_USB0_RAM_ADDR — USB0 RAM Address Register
  [15:0] VALUE
0x3B4 REG_USB0_RAM_DATA — USB0 RAM Data Register
  [15:0] VALUE
